## Zephyr board files/arm/Lemon_LTE_nrf9160/Kconfig.board
```kconfig
# nRF9160 Lemon IoT LTE board configuration

# Copyright (c) 2018-2020 Nordic Semiconductor ASA
# Copyright (c) 2022 Aaron Mohtar & Co Pty Ltd
# SPDX-License-Identifier: Apache-2.0

if SOC_NRF9160_SICA

config BOARD_LEMON_IOT_NRF9160
	bool "nRF9160 Lemon IoT LTE"

config BOARD_LEMON_IOT_NRF9160_NS
	bool "nRF9160 Lemon IoT LTE non-secure"

endif # SOC_NRF9160_SICA
```

## Zephyr board files/arm/lemon_iot_lte_nrf9160/Kconfig.board
```kconfig
# nRF9160 Lemon IoT LTE board configuration

# Copyright (c) 2022-2023 Aaron Mohtar & Co Pty Ltd
# Copyright (c) 2018-2020 Nordic Semiconductor ASA
# SPDX-License-Identifier: Apache-2.0

if SOC_NRF9160_SICA

config BOARD_LEMON_IOT_LTE_NRF9160
	bool "Lemon IoT LTE nRF9160"

config BOARD_LEMON_IOT_LTE_NRF9160_NS
	bool "Lemon IoT LTE nRF9160 non-secure"

endif # SOC_NRF9160_SICA
```
